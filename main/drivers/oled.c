#include "oled.h"

#include <stdio.h>
#include <string.h>

#include "driver/i2c_master.h"
#include "freertos/FreeRTOS.h"
#include "freertos/task.h"
#include "esp_lcd_panel_io.h"
#include "esp_lcd_panel_ops.h"
#include "esp_lcd_panel_ssd1306.h"

#include "app_config.h"
#include "i2c_bus.h"

#define OLED_FB_SIZE (OLED_WIDTH * OLED_PAGES)
#define OLED_CHAR_W  6
#define OLED_CHAR_H  8
#define FONT_FIRST   32
#define FONT_LAST    126
#define FONT_WIDTH   5
#define FONT_COUNT   (FONT_LAST - FONT_FIRST + 1)

static const uint8_t s_font[FONT_COUNT][FONT_WIDTH] = {
    { 0x00, 0x00, 0x00, 0x00, 0x00 },
    { 0x00, 0x00, 0x5F, 0x00, 0x00 },
    { 0x00, 0x07, 0x00, 0x07, 0x00 },
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    { 0x08, 0x04, 0x08, 0x10, 0x08 },
};

static esp_lcd_panel_io_handle_t  s_io;
static esp_lcd_panel_handle_t     s_panel;
static bool                       s_ready;
static uint8_t                    s_fb[OLED_FB_SIZE];

static esp_err_t oled_probe(uint8_t *address)
{
    const uint8_t candidates[] = { OLED_ADDR_PRIMARY, OLED_ADDR_ALT };

    for (size_t i = 0; i < sizeof(candidates) / sizeof(candidates[0]); i++) {
        if (i2c_master_probe(i2c_bus_handle(), candidates[i], OLED_I2C_TIMEOUT_MS) == ESP_OK) {
            *address = candidates[i];
            return ESP_OK;
        }
    }
    return ESP_ERR_NOT_FOUND;
}

static void oled_release(void)
{
    if (s_panel) {
        esp_lcd_panel_del(s_panel);
        s_panel = NULL;
    }
    if (s_io) {
        esp_lcd_panel_io_del(s_io);
        s_io = NULL;
    }
}

esp_err_t oled_init(void)
{
    if (s_ready) {
        return ESP_OK;
    }

    esp_err_t err = i2c_bus_init();
    if (err != ESP_OK) {
        printf("OLED I2C FAIL\n");
        fflush(stdout);
        return err;
    }

    uint8_t address = 0;
    err = oled_probe(&address);
    if (err != ESP_OK) {
        printf("OLED NOT FOUND\n");
        fflush(stdout);
        return err;
    }

    esp_lcd_panel_io_i2c_config_t io_config = {
        .dev_addr             = address,
        .scl_speed_hz         = OLED_I2C_SPEED_HZ,
        .control_phase_bytes  = 1,
        .dc_bit_offset        = 6,
        .lcd_cmd_bits         = 8,
        .lcd_param_bits       = 8,
        .transaction_timeout_ms = OLED_I2C_TIMEOUT_MS,
    };

    err = esp_lcd_new_panel_io_i2c(i2c_bus_handle(), &io_config, &s_io);
    if (err != ESP_OK) {
        goto fail;
    }

    esp_lcd_panel_ssd1306_config_t ssd1306_config = {
        .height = OLED_HEIGHT,
    };

    esp_lcd_panel_dev_config_t panel_config = {
        .bits_per_pixel = 1,
        .reset_gpio_num = -1,
        .vendor_config  = &ssd1306_config,
    };

    err = esp_lcd_new_panel_ssd1306(s_io, &panel_config, &s_panel);
    if (err != ESP_OK) {
        goto fail;
    }

    err = esp_lcd_panel_reset(s_panel);
    if (err != ESP_OK) {
        goto fail;
    }

    err = esp_lcd_panel_init(s_panel);
    if (err != ESP_OK) {
        goto fail;
    }

    err = esp_lcd_panel_disp_on_off(s_panel, true);
    if (err != ESP_OK) {
        goto fail;
    }

    s_ready = true;
    oled_clear();
    return ESP_OK;

fail:
    oled_release();
    return err;
}

bool oled_ready(void)
{
    return s_ready;
}

void oled_clear(void)
{
    if (!s_ready) {
        return;
    }
    memset(s_fb, 0, sizeof(s_fb));
}

void oled_fill(bool on)
{
    if (!s_ready) {
        return;
    }
    memset(s_fb, on ? 0xFF : 0x00, sizeof(s_fb));
}

void oled_text_line(uint8_t row, const char *text)
{
    if (!s_ready || row >= OLED_PAGES || text == NULL) {
        return;
    }

    uint8_t *page = s_fb + (size_t)row * OLED_WIDTH;
    memset(page, 0, OLED_WIDTH);

    for (uint8_t col = 0; col < OLED_COLS && text[col] != '\0'; col++) {
        char c = text[col];
        if (c < FONT_FIRST || c > FONT_LAST) {
            c = '?';
        }

        const uint8_t *glyph = s_font[c - FONT_FIRST];
        uint8_t *cell = page + (size_t)col * OLED_CHAR_W;
        for (uint8_t i = 0; i < FONT_WIDTH; i++) {
            cell[i] = glyph[i];
        }
        cell[FONT_WIDTH] = 0;
    }
}

void oled_flush(void)
{
    if (!s_ready) {
        return;
    }

    for (uint8_t page = 0; page < OLED_PAGES; page++) {
        uint8_t col_low  = 0x00 | (OLED_COL_OFFSET & 0x0F);
        uint8_t col_high = 0x10 | ((OLED_COL_OFFSET >> 4) & 0x0F);

        esp_lcd_panel_io_tx_param(s_io, 0xB0 | page, NULL, 0);
        esp_lcd_panel_io_tx_param(s_io, col_low, NULL, 0);
        esp_lcd_panel_io_tx_param(s_io, col_high, NULL, 0);
        esp_lcd_panel_io_tx_color(s_io, -1, s_fb + (size_t)page * OLED_WIDTH, OLED_WIDTH);
    }
}
